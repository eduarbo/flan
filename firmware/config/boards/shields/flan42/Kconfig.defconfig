## firmware/config/boards/shields/flan42/Kconfig.defconfig
```kconfig
if SHIELD_FLAN42_LEFT
config ZMK_KEYBOARD_NAME
 default "Flan42"
config ZMK_SPLIT_ROLE_CENTRAL
 default y
endif
if SHIELD_FLAN42_LEFT || SHIELD_FLAN42_RIGHT
config ZMK_SPLIT
 default y
endif
```

## firmware/config/boards/shields/flan42/Kconfig.shield
```kconfig
config SHIELD_FLAN42_LEFT
 def_bool $(shields_list_contains,flan42_left)
config SHIELD_FLAN42_RIGHT
 def_bool $(shields_list_contains,flan42_right)
```

## firmware/config/boards/shields/flan46/Kconfig.defconfig
```kconfig
if SHIELD_FLAN46_LEFT
config ZMK_KEYBOARD_NAME
 default "Flan46"
config ZMK_SPLIT_ROLE_CENTRAL
 default y
endif
if SHIELD_FLAN46_LEFT || SHIELD_FLAN46_RIGHT
config ZMK_SPLIT
 default y
endif
```

## firmware/config/boards/shields/flan46/Kconfig.shield
```kconfig
config SHIELD_FLAN46_LEFT
 def_bool $(shields_list_contains,flan46_left)
config SHIELD_FLAN46_RIGHT
 def_bool $(shields_list_contains,flan46_right)
```

## firmware/config/boards/shields/flan54/Kconfig.defconfig
```kconfig
if SHIELD_FLAN54_LEFT
config ZMK_KEYBOARD_NAME
 default "Flan54"
config ZMK_SPLIT_ROLE_CENTRAL
 default y
endif
if SHIELD_FLAN54_LEFT || SHIELD_FLAN54_RIGHT
config ZMK_SPLIT
 default y
endif
```

## firmware/config/boards/shields/flan54/Kconfig.shield
```kconfig
config SHIELD_FLAN54_LEFT
 def_bool $(shields_list_contains,flan54_left)
config SHIELD_FLAN54_RIGHT
 def_bool $(shields_list_contains,flan54_right)
```
